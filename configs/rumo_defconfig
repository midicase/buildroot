## configs/rumo_defconfig
```kconfig
BR2_x86_64=y
BR2_TOOLCHAIN_BUILDROOT_CXX=y
BR2_PACKAGE_FFMPEG=y
BR2_PACKAGE_LIBXML2=y
BR2_PACKAGE_FFMPEG_FFPROBE=y
BR2_PACKAGE_FFMPEG_SWSCALE=y
BR2_PACKAGE_CA_CERTIFICATES=y
BR2_PACKAGE_GNUTLS=y
BR2_PACKAGE_GNUTLS_OPENSSL=y
BR2_PACKAGE_JPEG=y
BR2_PACKAGE_SVTJPEGXS=y
BR2_PACKAGE_LIBCURL=y
BR2_PACKAGE_LIBCURL_CURL=y
BR2_PACKAGE_LIBURIPARSER=y
BR2_PACKAGE_SRT=y
BR2_PACKAGE_BOOST=y
BR2_PACKAGE_BOOST_FILESYSTEM=y
BR2_PACKAGE_HOST_ENVIRONMENT_SETUP=y
```

## configs/tangelo_defconfig
```kconfig
BR2_aarch64=y
BR2_KERNEL_HEADERS_6_6=y
BR2_TOOLCHAIN_BUILDROOT_CXX=y
BR2_TARGET_GENERIC_HOSTNAME="tangelo"
BR2_TARGET_GENERIC_ISSUE="Welcome to Tangelo"
BR2_ROOTFS_DEVICE_TABLE="system/device_table.txt board/ar-corp/tangelo/device_table.txt"
BR2_TARGET_GENERIC_ROOT_PASSWD="tangelo"
BR2_SYSTEM_BIN_SH_BASH=y
BR2_SYSTEM_DHCP="eth0"
BR2_TARGET_TZ_INFO=y
BR2_TARGET_LOCALTIME="America/New_York"
BR2_ROOTFS_OVERLAY="board/ar-corp/tangelo/rootfs_overlay"
BR2_ROOTFS_POST_BUILD_SCRIPT="board/ar-corp/tangelo/post-build.sh"
BR2_PACKAGE_BUSYBOX_CONFIG="board/ar-corp/tangelo/configs/busybox.config"
BR2_PACKAGE_BUSYBOX_SHOW_OTHERS=y
BR2_PACKAGE_P7ZIP=y
BR2_PACKAGE_P7ZIP_7ZA=y
BR2_PACKAGE_GDB=y
BR2_PACKAGE_SPIDEV_TEST=y
BR2_PACKAGE_DOSFSTOOLS=y
BR2_PACKAGE_DOSFSTOOLS_FSCK_FAT=y
BR2_PACKAGE_DOSFSTOOLS_MKFS_FAT=y
BR2_PACKAGE_E2FSPROGS=y
BR2_PACKAGE_DEJAVU=y
BR2_PACKAGE_ZLIB=y
BR2_PACKAGE_FREETYPE=y
BR2_PACKAGE_DTC=y
BR2_PACKAGE_DTC_PROGRAMS=y
BR2_PACKAGE_LIBGPIOD=y
BR2_PACKAGE_LIBGPIOD_TOOLS=y
BR2_PACKAGE_JSONCPP=y
BR2_PACKAGE_LIBFCGI=y
BR2_PACKAGE_LIBURIPARSER=y
BR2_PACKAGE_SRT=y
BR2_PACKAGE_BOOST=y
BR2_PACKAGE_MPFR=y
BR2_PACKAGE_AUGEAS=y
BR2_PACKAGE_CHRONY=y
BR2_PACKAGE_DROPBEAR=y
# BR2_PACKAGE_DROPBEAR_CLIENT is not set
BR2_PACKAGE_DROPBEAR_DISABLE_REVERSEDNS=y
BR2_PACKAGE_LIGHTTPD=y
BR2_PACKAGE_SUDO=y
BR2_PACKAGE_HTOP=y
BR2_PACKAGE_UTIL_LINUX_BINARIES=y
BR2_PACKAGE_UTIL_LINUX_PARTX=y
BR2_PACKAGE_NANO=y
# BR2_PACKAGE_NANO_TINY is not set
BR2_PACKAGE_HOST_ENVIRONMENT_SETUP=y
BR2_PACKAGE_HOST_MAKESELF=y
```

## package/srt/Config.in
```kconfig
config BR2_PACKAGE_SRT
	bool "srt"
	depends on BR2_TOOLCHAIN_HAS_THREADS
	help
	  open source video transport protocol that enables 
	  the delivery of high-quality and secure, low-latency 
	  video across the public Internet. 

	  https://github.com/Haivision/srt

comment "SRT needs a toolchain with thread support"
	depends on !BR2_TOOLCHAIN_HAS_THREADS
```

## package/svtjpegxs/Config.in
```kconfig
config BR2_PACKAGE_SVTJPEGXS
	bool "svtjpegxs"
	depends on BR2_TOOLCHAIN_HAS_THREADS
	help
	  JPEG XS is an image and video codec that offers visually
	  and mathematically lossless quality. It is a special-purpose 
	  codec that is specifically designed to allow for low-complexity 
	  and low-latency implementations.

	  https://github.com/OpenVisualCloud/SVT-JPEG-XS

comment "SvtJpegXS needs a toolchain with thread support"
	depends on !BR2_TOOLCHAIN_HAS_THREADS
```
