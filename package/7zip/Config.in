## package/7zip/Config.in
```kconfig
config BR2_PACKAGE_7ZIP
	bool "7zip"
	depends on BR2_TOOLCHAIN_HAS_SYNC_4 # __sync_*_4 intrinsics
	depends on BR2_INSTALL_LIBSTDCPP
	depends on BR2_TOOLCHAIN_HAS_THREADS
	depends on BR2_USE_WCHAR
	help
	  7-Zip is a file archiver with a high compression ratio.

	  This installs 7zz, the official Linux build of the full
	  7-Zip console program. It handles 7z (including AES
	  encryption), ZIP, XZ, GZIP, BZIP2, TAR, CPIO, RPM, DEB and
	  more. It replaces p7zip: same command line, but use 7zz
	  instead of 7za.

	  https://www.7-zip.org

comment "7zip needs a toolchain w/ threads, wchar, C++"
	depends on BR2_TOOLCHAIN_HAS_SYNC_4
	depends on !BR2_TOOLCHAIN_HAS_THREADS || !BR2_USE_WCHAR || \
		!BR2_INSTALL_LIBSTDCPP
```
